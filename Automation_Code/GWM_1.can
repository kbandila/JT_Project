/*@!Encoding:1252*/
includes
{
  
}

variables
{
  message Ball_Game_Mode_CAN CAN_BALL_GAME_MODE_CAN;
  message ABS_Msg_Data_CAN CAN_ABS_MSG_DATA_CAN;
  message RDS_Coder_Data_CAN CAN_RDS_CODER_DATA_CAN;
  
  
  msTimer TIMER_CAN_BALL_GAME_MODE_CAN;
  msTimer TIMER_CAN_ABS_MSG_DATA_CAN;
  
  
  const long TIMER_VALUE_CAN_BALL_GAME_MODE_CAN = 50;
  const long TIMER_VALUE_CAN_ABS_MSG_DATA_CAN = 1500;
}

On start
{
  settimer(TIMER_CAN_BALL_GAME_MODE_CAN, TIMER_VALUE_CAN_BALL_GAME_MODE_CAN);
  settimer(TIMER_CAN_ABS_MSG_DATA_CAN, TIMER_VALUE_CAN_ABS_MSG_DATA_CAN);
  
}

on timer TIMER_CAN_BALL_GAME_MODE_CAN
{
  sendBall_Game_Mode_CAN();
  settimer(TIMER_CAN_BALL_GAME_MODE_CAN, TIMER_VALUE_CAN_BALL_GAME_MODE_CAN);
  
 }
void sendBall_Game_Mode_CAN(void)
{
  byte can_miss_value;
  byte can_main_value;
  
  can_miss_value = @MissingSwitches::Sys_Miss_Ball_Game_Mode_CAN;
  can_main_value = @MissingSwitches::Sys_MainSwitch;
  
  if(can_miss_value == 0x0 && can_main_value == 0x0)
  {
    output(CAN_BALL_GAME_MODE_CAN);
  }
  else
  {
    //do nothing;
  }
}

on sysvar GWM::Sys_Actv_Live_1_Rq
{
  CAN_BALL_GAME_MODE_CAN.Actv_Live_1_Rq = @GWM::Sys_Actv_Live_1_Rq;
}

on sysvar GWM::Sys_Actv_Live_2_Rq
{
  CAN_BALL_GAME_MODE_CAN.Actv_Live_2_Rq = @GWM::Sys_Actv_Live_2_Rq;
}

On sysvar GWM::Sys_Preset_6_Bank_Rq
{
  CAN_BALL_GAME_MODE_CAN.Preset_6_Bank_Rq = @GWM::Sys_Preset_6_Bank_Rq;
}

On sysvar GWM::Sys_Preset_12_Bank_Rq
{
  byte Max_Value;
  if (Max_Value <= 0xF)
  {
    CAN_BALL_GAME_MODE_CAN.Preset_12_Bank_Rq = @GWM::Sys_Preset_12_Bank_Rq;
    
  }
  else
  {
    Write("Entered");
    OpenPanel("ERRORPOPUP");
  }
}

On sysvar GWM::Sys_FM_Menu_Data_Rq
{
  byte Max_Value;
  if(Max_Value <= 0xFF)
  {
    CAN_BALL_GAME_MODE_CAN.FM_Menu_Data_Rq = @GWM::Sys_FM_Menu_Data_Rq;
  }
  else
  {
    openpanel("ERRORPOPUP");
  }
}

On sysvar GWM::Sys_AM_Menu_Data_Rq
{
  byte Max_Value;
  if(Max_Value <= 0xFF)
  {
    CAN_BALL_GAME_MODE_CAN.AM_Menu_Data_Rq = @GWM::Sys_AM_Menu_Data_Rq;
  }
  else
  {
    openpanel("ERRORPOPUP");
  }
}

on timer TIMER_CAN_ABS_MSG_DATA_CAN
{
  SendABS_Msg_Data_CAN();
  settimer(TIMER_CAN_ABS_MSG_DATA_CAN, TIMER_VALUE_CAN_BALL_GAME_MODE_CAN);
}

void SendABS_Msg_Data_CAN(void)
{
  byte can_main_value;
  byte can_miss_value;
  
  can_miss_value = @MissingSwitches::Sys_Miss_ABS_Msg_Data_CAN;
  can_main_value = @MissingSwitches::Sys_MainSwitch;
  
  if(can_main_value == 0x0 && can_miss_value == 0x0)
  {
    output(CAN_ABS_MSG_DATA_CAN);
  }
  else
  {
    //do nothing;
  }
}

On sysvar GWM::Sys_HMI_MID_Sgnl_1_Rq
{
  byte Max_Value;
  if(Max_Value <= 0xF)
  {
    CAN_ABS_MSG_DATA_CAN.HMI_MID_Sgnl_1_Rq = @GWM::Sys_HMI_MID_Sgnl_1_Rq;
    SendABS_Msg_Data_CAN();
  }
  else
  {
    Openpanel("ERRORPOPUP");
  }
}

On sysvar GWM::Sys_HMI_MID_Sgnl_2_Rq
{
  byte Max_Value;
  if(Max_Value <= 0xF)
  {
    CAN_ABS_MSG_DATA_CAN.HMI_MID_Sgnl_2_Rq = @GWM::Sys_HMI_MID_Sgnl_2_Rq;
    SendABS_Msg_Data_CAN();
  }
  else
  {
    Openpanel("ERRORPOPUP");
  }
}

On sysvar GWM::Sys_HMI_MID_Sgnl_3_Rq
{
  byte Max_Value;
  if(Max_Value <= 0xF)
  {
    CAN_ABS_MSG_DATA_CAN.HMI_MID_Sgnl_3_Rq = @GWM::Sys_HMI_MID_Sgnl_3_Rq;
    SendABS_Msg_Data_CAN();
  }
  else
  {
    Openpanel("ERRORPOPUP");
  }
}
 
On sysvar GWM::Sys_MID_Data_Rq
{
  byte Max_Value;
  if(Max_Value <= 0xFF)
  {
    CAN_ABS_MSG_DATA_CAN.MID_Data_Rq = @GWM::Sys_MID_Data_Rq;
    SendABS_Msg_Data_CAN();
  }
  else
  {
    openpanel("ERRORPOPUP");
  }
}

On sysvar GWM::Sys_MID_Msg_Rq
{
  CAN_ABS_MSG_DATA_CAN.MID_Msg_Rq = @GWM::Sys_MID_Msg_Rq;
  SendABS_Msg_Data_CAN();
}

On sysvar GWM::Sys_Indictr_Lft_Dsply
{
  CAN_ABS_MSG_DATA_CAN.Indictr_Lft_Dsply = @GWM::Sys_Indictr_Lft_Dsply;
  SendABS_Msg_Data_CAN();
}

on sysvar GWM::Sys_Indictr_Rgt_Dsply
{
  CAN_ABS_MSG_DATA_CAN.Indictr_Rgt_Dsply = @GWM::Sys_Indictr_Rgt_Dsply;
  SendABS_Msg_Data_CAN();
}

void SendRDS_Coder_Data_CAN(void)
{
  byte can_main_value;
  can_main_value = @MissingSwitches::Sys_MainSwitch;
  if(can_main_value == 0x0)
  {
    output(CAN_RDS_CODER_DATA_CAN);
  }
}

on sysvar GWM::Sys_TA_Data_Rq
{
  CAN_RDS_CODER_DATA_CAN.TA_Data_Rq = @GWM::Sys_TA_Data_Rq;
  SendRDS_Coder_Data_CAN();
}

on sysvar GWM::Sys_TP_Data_Rq
{
  byte Max_value;
  if(Max_value <= 0xF)
  {
    CAN_RDS_CODER_DATA_CAN.TP_Data_Rq = @GWM::Sys_TP_Data_Rq;
    SendRDS_Coder_Data_CAN();
  }
  else
  {
    openpanel("ERRORPOPUP");
  }
}

On sysvar GWM::Sys_Sig_Spdmtr_Rq
{
  byte Max_value;
  if(Max_value <= 0xF0)
  {
    CAN_RDS_CODER_DATA_CAN.Sig_Spdmtr_Rq = @GWM::Sys_Sig_Spdmtr_Rq;
    SendRDS_Coder_Data_CAN();
  }
  else
  {
    openpanel("ERRORPOPUP");
  }
}

On sysvar GWM::Sys_AHB_Dsply
{
  CAN_RDS_CODER_DATA_CAN.Ahb_Dsply = @GWM::Sys_AHB_Dsply;
  SendRDS_Coder_Data_CAN();
}
    
    
  
  